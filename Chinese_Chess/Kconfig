## Whackmole/Kconfig
```kconfig
 
config LVX_USE_DEMO_WHACKMOLE
    bool "Whackmole"
    default n
    help
      Enable the demo Whackmole application.

if LVX_USE_DEMO_WHACKMOLE
config LVX_WHACKMOLE_DATA_ROOT
    string "Whackmole Data Root"
    default "/sdcard"
    help
      Specify the data storage path for the Whackmole application.
endif
```

## ai_chat/Kconfig
```kconfig
#
# For a description of the syntax of this configuration file,
# see the file kconfig-language.txt in the NuttX tools repository.
#

config AI_CONVERSATION_DEMO
	bool "AI-chat"
	select MEDIA
	select MEDIA_SERVER
	select LIBUV_EXTENSION
	select LIB_JSONC
	select CRYPTO_MBEDTLS
	select OPENSSL_MBEDTLS_WRAPPER
	select NETUTILS_LIBWEBSOCKETS
	default n

if AI_CONVERSATION_DEMO

config AI_VOLC_PLUGIN
	bool "AI chat volc plugin"
	default n

if AI_VOLC_PLUGIN

config VOLC_PULGIN_API_KEY
	string "volc plugin api key"
	default "API_KEY"

endif # AI_VOLC_PLUGIN

config AI_CONVERSATION_RECORDER_STREAM
	string "AI conversation recorder stream"
	default "Capture"

config AI_CONVERSATION_MUSIC_PATH
	string "AI conversation recorder device"
	default "/data/res/music"

config AI_CONVERSATION_GUI_FONT_PATH
	string "AI conversation GUI font path"
	default "/data/res/fonts"

config AI_CONVERSATION_GUI_ICONS_PATH
	string "AI conversation GUI image path"
	default "/data/res/icons"

config AI_CONVERSATION_GUI_STACKSIZE
	int "AI conversation GUI stack size"
	default 32768

config AI_CONVERSATION_GUI_PRIORITY
	int "AI conversation GUI priority"
	default 100

choice
	prompt "Conversation log level"
	default CONVERSATION_LOG_INFO

config CONVERSATION_LOG_DEBUG
	bool "CONVERSATION_LOG_DEBUG"

config CONVERSATION_LOG_INFO
	bool "CONVERSATION_LOG_INFO"

config CONVERSATION_LOG_WARN
	bool "CONVERSATION_LOG_WARN"

config CONVERSATION_LOG_ERR
	bool "CONVERSATION_LOG_ERR"

config CONVERSATION_LOG_SLIENT
	bool "CONVERSATION_LOG_SLIENT"

endchoice

endif # AI_CONVERSATION_DEMO
```

## bailian/Kconfig
```kconfig
config AI_BAILIAN
	tristate "Bailian SDK adaptation"
	default n
	select AUDIOUTILS_NXAUDIO
	select SYSTEM_NXRECORDER
	---help---
		Enable the openvela Bailian SDK adaptation example.

if AI_BAILIAN

config AI_BAILIAN_PROGNAME
	string "Program name"
	default "bailian"
	---help---
		This is the name of the program that will be used when the NSH ELF
		program is installed.

config AI_BAILIAN_PRIORITY
	int "Bailian task priority"
	default 100

config AI_BAILIAN_STACKSIZE
	int "Bailian stack size"
	default 8192

config AI_BAILIAN_HEAPSIZE
	int "Bailian heap size"
	depends on MM_TASK_HEAP
	default MM_TASK_HEAP_DEFAULT_SIZE

config AI_BAILIAN_WORKSPACE_ID
	string "Workspace ID"
	default ""

config AI_BAILIAN_APP_ID
	string "App ID"
	default ""

config AI_BAILIAN_API_KEY
	string "API Key"
	default ""

# License mode configs removed - using pay-as-you-go mode
config AI_BAILIAN_RECORDER_DEV
	string "Recorder device path"
	default "/dev/audio/pcm0c"

config AI_BAILIAN_PLAYER_DEV
	string "Player device path"
	default "/dev/audio/pcm0p"

endif
```
